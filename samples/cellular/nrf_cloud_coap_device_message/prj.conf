## CMakeLists.txt
```
#
# Copyright (c) 2025 Nordic Semiconductor
#
# SPDX-License-Identifier: LicenseRef-Nordic-5-Clause
#

cmake_minimum_required(VERSION 3.20.0)

find_package(Zephyr REQUIRED HINTS $ENV{ZEPHYR_BASE})
project(nrf_cloud_device_message_sample)

target_sources(app PRIVATE src/main.c src/jwt_impl.c)
zephyr_include_directories(config)
```

## prj.conf
```kconfig
# Sample
CONFIG_NRF_CLOUD_COAP_DEVICE_MESSAGE_SAMPLE_LOG_LEVEL_INF=y

# nRF Cloud CoAP
CONFIG_NRF_CLOUD=y
CONFIG_NRF_CLOUD_COAP=y
CONFIG_NRF_CLOUD_COAP_DOWNLOADS=n
CONFIG_NRF_CLOUD_CHECK_CREDENTIALS=y
CONFIG_NRF_CLOUD_CLIENT_ID_SRC_INTERNAL_UUID=y

# CoAP Client
CONFIG_COAP_CLIENT_BLOCK_SIZE=1024
CONFIG_COAP_CLIENT_STACK_SIZE=6144
CONFIG_COAP_CLIENT_THREAD_PRIORITY=0
CONFIG_COAP_EXTENDED_OPTIONS_LEN_VALUE=40

# # LTE link control
# CONFIG_LTE_LC_PSM_MODULE=y
# CONFIG_LTE_LINK_CONTROL=y

# # LEDS and buttons
# CONFIG_LED=y
# CONFIG_LED_GPIO=y
# CONFIG_DK_LIBRARY=y

# Networking
CONFIG_NETWORKING=y
CONFIG_NET_SOCKETS=y
# CONFIG_NET_SOCKETS_OFFLOAD=y

# Enable LTE Connectivity using Connection Manager
CONFIG_NET_IPV4=y
CONFIG_NET_IPV6=y
CONFIG_NET_IPV6_NBR_CACHE=n
CONFIG_NET_IPV6_MLD=n
CONFIG_NET_CONNECTION_MANAGER=y
# CONFIG_NRF_MODEM_LIB=y
# CONFIG_NRF_MODEM_LIB_NET_IF=y
# CONFIG_NRF_MODEM_LIB_NET_IF_AUTO_DOWN=y
# CONFIG_NRF_MODEM_LIB_NET_IF_DOWN_DEFAULT_LTE_DISCONNECT=y
CONFIG_NET_CONNECTION_MANAGER_MONITOR_STACK_SIZE=1024
CONFIG_NET_MGMT_EVENT_STACK_SIZE=1024

# # LTE link control
# CONFIG_LTE_LINK_CONTROL=y

# System
CONFIG_HEAP_MEM_POOL_SIZE=19000
CONFIG_MAIN_STACK_SIZE=3072
CONFIG_SYSTEM_WORKQUEUE_STACK_SIZE=2048
CONFIG_ASSERT=y
CONFIG_REBOOT=y
CONFIG_FPU=y
CONFIG_PICOLIBC_IO_FLOAT=y
CONFIG_EVENTS=y
CONFIG_POSIX_API=y

# Logging
CONFIG_LOG=y
CONFIG_LOG_MODE_DEFERRED=y
CONFIG_UART_INTERRUPT_DRIVEN=y
CONFIG_NRF_CLOUD_ALERT=y
CONFIG_NRF_CLOUD_ALERT_LOG_LEVEL_WRN=y
CONFIG_NRF_CLOUD_LOG_DIRECT=y
CONFIG_NRF_CLOUD_LOG_OUTPUT_LEVEL=3

# Needed for time-stamping messages
# CONFIG_DATE_TIME=y
# CONFIG_DATE_TIME_NTP=y
CONFIG_PRINTK=y

# # AT Host
# CONFIG_AT_HOST_LIBRARY=y
# CONFIG_AT_MONITOR_HEAP_SIZE=4096
# CONFIG_AT_HOST_STACK_SIZE=2048

# Enable settings storage
CONFIG_SETTINGS=y
CONFIG_SETTINGS_FCB=y
CONFIG_FCB=y
CONFIG_FLASH_MAP=y
CONFIG_FLASH=y
CONFIG_FLASH_PAGE_LAYOUT=y

# # Modem info
# CONFIG_MODEM_INFO=y
# CONFIG_MODEM_INFO_ADD_DEVICE=n
# CONFIG_MODEM_INFO_ADD_NETWORK=n
# CONFIG_MODEM_INFO_ADD_SIM=n

# # Modem key management
# CONFIG_MODEM_KEY_MGMT=y
# CONFIG_MODEM_JWT=y
# CONFIG_NRF_CLOUD_SEC_TAG=16842753

# ESP32-C6 settings
CONFIG_WIFI=y
CONFIG_WIFI_LOG_LEVEL_ERR=y
CONFIG_SHELL=y
CONFIG_NET_L2_WIFI_SHELL=y

# instead of using nrf cloud JWT lib, use the zephyr one
CONFIG_JWT=y
CONFIG_APP_JWT=y
CONFIG_BASE64=y
CONFIG_TLS_CREDENTIALS_SHELL=y

# CONFIG_NRF_CLOUD_JWT_SOURCE_CUSTOM=y
CONFIG_NRF_CLOUD_CLIENT_ID_SRC_HW_ID=y
CONFIG_HWINFO=y
CONFIG_HW_ID_LIBRARY=y

# Enable SNTP + auto SNTP time sync
CONFIG_SNTP=y
CONFIG_SNTP=y
CONFIG_NET_CONFIG_CLOCK_SNTP_INIT=y
CONFIG_NET_CONFIG_SNTP_INIT_SERVER="time.nist.gov"
CONFIG_NET_CONFIG_SNTP_INIT_RESYNC=y

CONFIG_MEMFAULT=y
CONFIG_MEMFAULT_NCS_DEVICE_INFO_CUSTOM=y
```

## src/main.c
```c
/*
 * Copyright (c) 2025 Nordic Semiconductor ASA
 *
 * SPDX-License-Identifier: LicenseRef-Nordic-5-Clause
 */

#include <zephyr/kernel.h>
#include <zephyr/settings/settings.h>
#include <zephyr/net/conn_mgr_connectivity.h>
#include <net/nrf_cloud.h>
#include <net/nrf_cloud_log.h>
#include <net/nrf_cloud_alert.h>
#include <net/nrf_cloud_defs.h>
#include <net/nrf_cloud_coap.h>
#include <zephyr/logging/log.h>
#include <zephyr/logging/log_ctrl.h>
#include <date_time.h>
#include <zephyr/random/random.h>
#include <app_version.h>
#include <time.h>

LOG_MODULE_REGISTER(nrf_cloud_coap_device_message,
		    CONFIG_NRF_CLOUD_COAP_DEVICE_MESSAGE_SAMPLE_LOG_LEVEL);

/* Boot message */
#define SAMPLE_SIGNON_FMT "nRF Cloud CoAP Device Message Sample, version: %s"

/* Example message */
#define SAMPLE_MSG_FMT	"{\"sample_message\":"\
				"\"Hello World, from the CoAP Device Message Sample! "\
				"Message ID: %lld\"}"
#define SAMPLE_MSG_BUF_SIZE (sizeof(SAMPLE_MSG_FMT) + 19)

/* Network states */
#define NETWORK_UP		  BIT(0)
#define EVENT_MASK		  (NET_EVENT_L4_CONNECTED | NET_EVENT_L4_DISCONNECTED)

/* Connection event */
static K_EVENT_DEFINE(connection_events);

/* nRF Cloud device ID */
static char device_id[NRF_CLOUD_CLIENT_ID_MAX_LEN + 1];

#define COAP_SHADOW_MAX_SIZE 512


static bool cred_check(struct nrf_cloud_credentials_status *const cs)
{
	int ret = 0;

	ret = nrf_cloud_credentials_check(cs);
	if (ret) {
		LOG_ERR("nRF Cloud credentials check failed, error: %d", ret);
		return false;
	}

	/* Since this is a CoAP sample, we only need two credentials:
	 *  - a CA for the TLS connections
	 *  - a private key to sign the JWT
	 */

	if (!cs->ca || !cs->ca_aws || !cs->prv_key) {
		LOG_WRN("Missing required nRF Cloud credential(s) in sec tag %u:", cs->sec_tag);
	}
	if (!cs->ca || !cs->ca_aws) {
		LOG_WRN("\t-CA Cert");
	}
	if (!cs->prv_key) {
		LOG_WRN("\t-Private Key");
	}

	return (cs->ca && cs->ca_aws && cs->prv_key);
}

static void await_credentials(void)
{
	struct nrf_cloud_credentials_status cs;

	while (!cred_check(&cs)) {
		LOG_INF("Waiting for credentials to be installed...");
		LOG_INF("Press the reset button once the credentials are installed");
		k_sleep(K_FOREVER);
	}

	LOG_INF("nRF Cloud credentials detected!");
}

static int send_message(const char *const msg)
{
	int ret = 0;

	LOG_INF("Sending message:'%s'", msg);

	/* Send the message to nRF Cloud */
	ret = nrf_cloud_coap_json_message_send(msg, false, true);
	if (ret) {
		LOG_ERR("Failed to send device message via REST: %d", ret);
	} else {
		LOG_INF("Message sent");
	}

	return ret;
}

static void report_startup(void)
{
	int err = 0;
	int reset_reason = 0;

	err = nrf_cloud_alert_send(ALERT_TYPE_DEVICE_NOW_ONLINE,
				   reset_reason, NULL);

	if (err) {
		LOG_ERR("Error sending alert to cloud: %d", err);
	}

	(void)nrf_cloud_log_send(LOG_LEVEL_INF,
				 SAMPLE_SIGNON_FMT,
				 APP_VERSION_STRING);

	if (err) {
		LOG_ERR("Error sending direct log to cloud: %d", err);
	}
}

static int send_hello_world_msg(void)
{
	int err = 0;
	int64_t time_now = 0;
	char buf[SAMPLE_MSG_BUF_SIZE];

	/* Get the current timestamp */
	time_now = (int64_t)time(NULL);
	if (time_now <= 0) {
		LOG_ERR("Failed to get timestamp, using random number");
		sys_rand_get(&time_now, sizeof(time_now));
	}

	/* Send off a hello world message! */
	err = snprintk(buf, SAMPLE_MSG_BUF_SIZE, SAMPLE_MSG_FMT, time_now);
	if (err < 0 || err > SAMPLE_MSG_BUF_SIZE) {
		LOG_ERR("Failed to create Hello World message.");
		return err;
	}

	err = send_message(buf);
	if (err) {
		LOG_ERR("Failed to send Hello World message");
	} else {
		LOG_INF("Sent Hello World message with ID: %lld", time_now);
	}

	return err;
}


static int shadow_support_coap_obj_send(struct nrf_cloud_obj *const shadow_obj, const bool reported)
{
	/* Encode the data for the cloud */
	int err = nrf_cloud_obj_cloud_encode(shadow_obj);

	/* Free the object */
	(void)nrf_cloud_obj_free(shadow_obj);

	if (!err) {
		/* Send the encoded data */
		if (!reported) {
			err = nrf_cloud_coap_shadow_desired_update(shadow_obj->encoded_data.ptr);
		} else {
			err = nrf_cloud_coap_shadow_state_update(shadow_obj->encoded_data.ptr);
		}
	} else {
		LOG_ERR("Failed to encode cloud data, err: %d", err);
		return err;
	}

	/* Free the encoded data */
	(void)nrf_cloud_obj_cloud_encoded_free(shadow_obj);

	return err;
}

static void send_initial_log_level(void)
{
	NRF_CLOUD_OBJ_JSON_DEFINE(root_obj);
	NRF_CLOUD_OBJ_JSON_DEFINE(ctrl_obj);
	int err;

	err = nrf_cloud_obj_init(&root_obj);
	if (err) {
		LOG_ERR("Failed to initialize root object: %d", err);
		goto cleanup;
	}

	err = nrf_cloud_obj_init(&ctrl_obj);
	if (err) {
		LOG_ERR("Failed to initialize config object: %d", err);
		(void)nrf_cloud_obj_free(&root_obj);
		goto cleanup;
	}

	/* Create the config object */
	err = nrf_cloud_obj_num_add(&ctrl_obj, NRF_CLOUD_JSON_KEY_LOG,
		(double)nrf_cloud_log_control_get(), false);
		if (err) {
			LOG_ERR("Failed to add reported log level, error: %d", err);
			goto cleanup;
		}

	/* Add the config object to the root object */
	err = nrf_cloud_obj_object_add(&root_obj, NRF_CLOUD_JSON_KEY_CTRL, &ctrl_obj, false);
	if (err) {
		LOG_ERR("Failed to add config object to root object: %d", err);
		goto cleanup;
	}

	/* Send the initial config */
	err = shadow_support_coap_obj_send(&root_obj, true);
	if (err) {
		LOG_ERR("Failed to send initial config, error: %d", err);
	} else {
		LOG_INF("Initial config sent");
	}
cleanup:
	(void)nrf_cloud_obj_free(&ctrl_obj);
	(void)nrf_cloud_obj_free(&root_obj);
}

static void check_desired_log_level(void)
{
	/* Ensure the reported section gets sent once */
	static bool reported_sent;
	/* Only request full shadow the first time */
	static bool request_delta;
	char buf[COAP_SHADOW_MAX_SIZE] = {0};
	size_t buf_len = sizeof(buf);
	double desired_log_level = -1;
	bool update_reported = false;
	struct nrf_cloud_data in_data = {
		.ptr = buf
	};
	struct nrf_cloud_obj delta_obj = {0};
	int err;

	LOG_INF("Checking for shadow delta...");
	err = nrf_cloud_coap_shadow_get(buf, &buf_len, false, COAP_CONTENT_FORMAT_APP_JSON);
	if (err == -EACCES) {
		LOG_DBG("Not connected yet.");
		goto exit;
	} else if (err) {
		LOG_ERR("Failed to request shadow delta: %d", err);
		goto exit;
	}
	LOG_DBG("Shadow: len:%zd, %s", strnlen(buf, buf_len), buf);
	request_delta = true;
	in_data.len = buf_len;

	if (strnlen(buf, buf_len) == 0) {
		LOG_DBG("No shadow delta available");
		goto exit;
	}

	/* Convert string into nrf_cloud_obj */
	err = nrf_cloud_coap_shadow_delta_process(&in_data, &delta_obj);
	if (err < 0) {
		LOG_ERR("Failed to process shadow delta, err: %d", err);
		goto exit;
	} else if (err == 0) {
		/* No application specific delta data */
		goto exit;
	}

	NRF_CLOUD_OBJ_JSON_DEFINE(ctrl_obj);

	/* Get the config object */
	err = nrf_cloud_obj_object_detach(&delta_obj, NRF_CLOUD_JSON_KEY_CTRL, &ctrl_obj);
	if (err == -ENODEV) {
		/* No config in the delta */
		goto exit;
	}

	/* Process incoming config */
	(void) nrf_cloud_obj_num_get(&ctrl_obj, NRF_CLOUD_JSON_KEY_LOG, &desired_log_level);

	/* Validate desired log level */
	LOG_INF("Desired log level: %d", (int)desired_log_level);

	if (desired_log_level < LOG_LEVEL_NONE || desired_log_level > LOG_LEVEL_DBG) {
		LOG_ERR("Invalid desired log level: %d", (int)desired_log_level);
		desired_log_level = CONFIG_NRF_CLOUD_COAP_DEVICE_MESSAGE_SAMPLE_LOG_LEVEL;
	} else {
		update_reported = (desired_log_level != nrf_cloud_log_control_get());
	}
	nrf_cloud_log_control_set(desired_log_level);

	/* Create config object for response */
	/* Note: this is simpler than trying to handle unsupported entries directly. */
	nrf_cloud_obj_free(&ctrl_obj);
	nrf_cloud_obj_init(&ctrl_obj);
	err = nrf_cloud_obj_num_add(&ctrl_obj, NRF_CLOUD_JSON_KEY_LOG,
				    desired_log_level, false);
	if (err) {
		LOG_ERR("Failed to add reported log level, error: %d", err);
		goto exit;
	}

	/* Add current config data */
	if (nrf_cloud_obj_object_add(&delta_obj, NRF_CLOUD_JSON_KEY_CFG, &ctrl_obj, false)) {
		goto exit;
	}

	/* Send Shadow update */
	if (update_reported || !reported_sent) {
		err = shadow_support_coap_obj_send(&delta_obj, update_reported);

		if (err) {
			LOG_ERR("Failed to send updated shadow delta, error: %d", err);
		} else {
			reported_sent = true;
			LOG_INF("Updated shadow delta sent");
		}
	}
exit:
	/* Free the objects */
	nrf_cloud_obj_free(&ctrl_obj);
	nrf_cloud_obj_free(&delta_obj);

	/* If the reported section was not sent, send the initial log level */
	if (!reported_sent) {
		send_initial_log_level();
	}
}

static void await_ntp_sync(void)
{
	int err = 1;

	LOG_INF("Waiting for NTP time synchronization...");

	/* dumb as hell, just poll until we get rt offset that seems reasonable */
	int wait_limit = 100;
	while(wait_limit-- > 0) {
		struct timespec tp;
		sys_clock_getrtoffset(&tp);
		if (tp.tv_sec > 100000) {
			err = 0;
			break;
		}
	}
	if (err) {
		LOG_ERR("NTP time synchronization didn't happen within timeout");
	} else {
		LOG_INF("NTP time synchronized!");
		/* log current broken down time, iso 8601 */
		struct tm cur_time;
		time_t now;
		time(&now);
		gmtime_r(&now, &cur_time);
		LOG_INF("Current time: %04d-%02d-%02dT%02d:%02d:%02dZ",
			cur_time.tm_year + 1900, cur_time.tm_mon + 1,
			cur_time.tm_mday, cur_time.tm_hour,
			cur_time.tm_min, cur_time.tm_sec);
	}
}

static int setup(void)
{
	int err = 0;

	/* todo- initialize wifi? */

	/* Ensure device has credentials installed before proceeding */
	await_credentials();

	/* Get the device ID */
	err = nrf_cloud_client_id_get(device_id, sizeof(device_id));
	if (err) {
		LOG_ERR("Failed to get device ID, error: %d", err);
		return err;
	}

	/* Initiate Connection */
	LOG_INF("Enabling connectivity...");
	conn_mgr_all_if_connect(true);
	k_event_wait(&connection_events, NETWORK_UP, false, K_FOREVER);

	/* Wait until we know what time it is (necessary for JSON Web Token generation) */
	await_ntp_sync();

	/* nRF Cloud CoAP requires login */
	err = nrf_cloud_coap_init();
	if (err) {
		LOG_ERR("Failed to initialize CoAP client: %d", err);
		return err;
	}
	err = nrf_cloud_coap_connect(NULL);
	if (err) {
		LOG_ERR("Connecting to nRF Cloud failed, error: %d", err);
		return 0;
	}

	/* Initialize the nRF Cloud logging subsystem */
	nrf_cloud_log_init();

	check_desired_log_level();

	return 0;
}

/* Callback to track network connectivity */
static struct net_mgmt_event_callback l4_callback;
static void l4_event_handler(struct net_mgmt_event_callback *cb, uint64_t event,
			     struct net_if *iface)
{
	if ((event & EVENT_MASK) != event) {
		return;
	}

	if (event == NET_EVENT_L4_CONNECTED) {
		/* Mark network as up. */
		LOG_INF("Connected to network");
		k_event_post(&connection_events, NETWORK_UP);
	}

	if (event == NET_EVENT_L4_DISCONNECTED) {
		/* Mark network as down. */
		LOG_INF("Network connectivity lost!");
	}
}

/* Start tracking network availability */
static int prepare_network_tracking(void)
{
	net_mgmt_init_event_callback(&l4_callback, l4_event_handler, EVENT_MASK);
	net_mgmt_add_event_callback(&l4_callback);

	return 0;
}

SYS_INIT(prepare_network_tracking, APPLICATION, 0);

static void prv_send_test_message(void) {
	static unsigned int count = 0;
	const char *msg_fmt = "{\"appId\":\"BUTTON\", \"messageType\":\"DATA\", \"data\":\"%d\"}";
	char msg_buf[100];
	int err = snprintk(msg_buf, sizeof(msg_buf), msg_fmt, count);
	if (err < 0 || err >= sizeof(msg_buf)) {
		LOG_ERR("Failed to create test message");
		return;
	}
	(void)send_message(msg_buf);

	(void)nrf_cloud_log_send(LOG_LEVEL_INF, "Button pressed %u times", ++count);
}


#include <zephyr/shell/shell.h>
#include "jwt_impl.h"

static int cmd_send_test_msg(const struct shell *shell, size_t argc, char **argv)
{
	prv_send_test_message();
	return 0;
}

SHELL_STATIC_SUBCMD_SET_CREATE(sample_cmds,
	SHELL_CMD(test_msg, NULL, "Send test message to nRF Cloud", cmd_send_test_msg),
	SHELL_SUBCMD_SET_END
);

SHELL_CMD_REGISTER(sample, &sample_cmds, "Sample commands", NULL);
#include "banner.h"
void prv_print_banner(void)
{
	printk(banner);
}

int main(void)
{
	int err = 0;

	LOG_INF(SAMPLE_SIGNON_FMT, APP_VERSION_STRING);

	prv_print_banner();

	err = setup();
	if (err) {
		LOG_ERR("Setup failed, stopping.");
		return 0;
	}

	/* Send alert and log message to the cloud. */
	report_startup();

	err = send_hello_world_msg();

	/* Sleep forever */
	k_sleep(K_FOREVER);
}
```

## src/jwt_impl.c
```c
/*
 * Copyright (c) 2025 Nordic Semiconductor ASA
 *
 * SPDX-License-Identifier: LicenseRef-Nordic-5-Clause
 */

#include <zephyr/kernel.h>
#include <zephyr/logging/log.h>
#include <zephyr/sys/base64.h>
#include <zephyr/net/tls_credentials.h>
#include <psa/crypto.h>
#include <app_jwt.h>
#include <net/nrf_cloud.h>
#include "nrf_cloud_client_id.h"
#include "jwt_impl.h"

LOG_MODULE_REGISTER(jwt_impl, CONFIG_NRF_CLOUD_COAP_DEVICE_MESSAGE_SAMPLE_LOG_LEVEL);

/* JWT constants from nrf_cloud_jwt.c */
#define PRV_KEY_SZ (32)
#define PRV_KEY_DER_SZ (138)
#define PRV_KEY_PEM_SZ (256)
#define PRV_KEY_DER_START_IDX (36)
#define BEGIN_PRV_KEY "-----BEGIN PRIVATE KEY-----"
#define END_PRV_KEY "-----END PRIVATE KEY-----"

static void remove_newlines(char *const str)
{
	size_t new;
	size_t len = strlen(str);

	for (size_t old = new = 0; old < len; ++old) {
		if (str[old] != '\n') {
			str[new++] = str[old];
		}
	}
	str[new] = '\0';
}

static int strip_non_key_data(char *const str)
{
	char *start;
	char *end;
	size_t new_len;

	/* Find and remove end string */
	end = strstr(str, END_PRV_KEY);
	if (end == NULL) {
		return -EINVAL;
	}
	*end = '\0';

	/* Find and remove begin string */
	start = strstr(str, BEGIN_PRV_KEY);
	if (start == NULL) {
		return -EINVAL;
	}

	start += strlen(BEGIN_PRV_KEY);
	new_len = strlen(start);

	/* Move key data to the front */
	memmove(str, start, new_len);
	str[new_len] = '\0';

	remove_newlines(str);
	return 0;
}

static int get_key_from_cred(const int sec_tag, uint8_t *const der_out)
{
	static char pem[PRV_KEY_PEM_SZ];
	static uint8_t der[PRV_KEY_DER_SZ];
	size_t pem_sz = sizeof(pem);
	size_t der_sz;
	int err;

	/* Get the private key from the TLS credentials subsystem */
	err = tls_credential_get(sec_tag, TLS_CREDENTIAL_PRIVATE_KEY, pem, &pem_sz);
	if (err) {
		LOG_ERR("tls_credential_get() failed, error: %d", err);
		return err;
	}

	err = strip_non_key_data(pem);
	if (err) {
		LOG_ERR("Failed to parse PEM file, error: %d", err);
		return err;
	}

	pem_sz = strlen(pem);

	/* Convert the PEM to DER (binary) */
	err = base64_decode(der, sizeof(der), &der_sz, pem, pem_sz);
	if (err) {
		LOG_ERR("base64_decode() failed, error: %d", err);
		return -EBADF;
	}

	const uint8_t expected_der_header[] = {0x30, 0x81, 0x87, 0x02};

	/* Verify that key header has the expected format */
	if (memcmp(der, expected_der_header, sizeof(expected_der_header))) {
		LOG_ERR("Unexpected DER format: 0x%X 0x%X 0x%X", der[0], der[1], der[2]);
		return -EBADF;
	}

	/* Copy the private key material */
	memcpy(der_out, &der[PRV_KEY_DER_START_IDX], PRV_KEY_SZ);
	return 0;
}

static int custom_jwt_generate(uint32_t exp_delta_s, char *const jwt_buf, size_t jwt_buf_sz,
			       const char *subject, int sec_tag)
{
	int err = 0;
	psa_key_id_t kid;
	psa_key_attributes_t key_attributes = PSA_KEY_ATTRIBUTES_INIT;
	uint8_t priv_key[PRV_KEY_SZ];

	/* Load private key from storage */
	err = get_key_from_cred(sec_tag, priv_key);
	if (err) {
		LOG_ERR("Failed to get private key, error: %d", err);
		return err;
	}

	err = psa_crypto_init();
	if (err != PSA_SUCCESS) {
		LOG_ERR("psa_crypto_init failed! (Error: %d)", err);
		return err;
	}

	psa_set_key_usage_flags(&key_attributes,
				PSA_KEY_USAGE_SIGN_MESSAGE | PSA_KEY_USAGE_VERIFY_MESSAGE);
	psa_set_key_lifetime(&key_attributes, PSA_KEY_LIFETIME_VOLATILE);
	psa_set_key_algorithm(&key_attributes, PSA_ALG_ECDSA(PSA_ALG_SHA_256));
	psa_set_key_type(&key_attributes, PSA_KEY_TYPE_ECC_KEY_PAIR(PSA_ECC_FAMILY_SECP_R1));
	psa_set_key_bits(&key_attributes, 256);

	/* Import key into PSA */
	err = psa_import_key(&key_attributes, priv_key, sizeof(priv_key), &kid);
	if (err != PSA_SUCCESS) {
		LOG_ERR("psa_import_key failed! (Error: %d)", err);
		return err;
	}

	/* Use app_jwt to generate the token */
	struct app_jwt_data jwt_data = {
		.sec_tag = kid,
		.key_type = JWT_KEY_TYPE_CLIENT_PRIV,
		.alg = JWT_ALG_TYPE_ES256,
		.validity_s = exp_delta_s,
		.jwt_buf = jwt_buf,
		.jwt_sz = jwt_buf_sz,
		.subject = subject,
	};

	err = app_jwt_generate(&jwt_data);

	/* Clean up the key */
	psa_destroy_key(kid);

	return err;
}

/* Full implementation of nrf_cloud_jwt_generate using app_jwt */
int nrf_cloud_jwt_generate(uint32_t time_valid_s, char *const jwt_buf, size_t jwt_buf_sz)
{
	if (!jwt_buf || !jwt_buf_sz) {
		return -EINVAL;
	}

	int err;
	const char *id_ptr;
	uint32_t exp_delta_s = time_valid_s;
	int sec_tag = IS_ENABLED(CONFIG_NRF_CLOUD_COAP) ? nrf_cloud_sec_tag_coap_jwt_get()
							: nrf_cloud_sec_tag_get();
	const char *subject;

	/* Validate and set expiration time */
	if (time_valid_s > NRF_CLOUD_JWT_VALID_TIME_S_MAX) {
		exp_delta_s = NRF_CLOUD_JWT_VALID_TIME_S_MAX;
	} else if (time_valid_s == 0) {
		exp_delta_s = NRF_CLOUD_JWT_VALID_TIME_S_DEF;
	}

	/* Get device ID for subject */
	if (IS_ENABLED(CONFIG_NRF_CLOUD_CLIENT_ID_SRC_INTERNAL_UUID)) {
		/* The UUID is present in the iss claim, so there is no need
		 * to also include it in the sub claim.
		 */
		subject = NULL;
	} else {
		err = nrf_cloud_client_id_ptr_get(&id_ptr);
		if (err) {
			LOG_ERR("Failed to obtain client ID, error: %d", err);
			return err;
		}
		subject = id_ptr;
	}

	/* Generate JWT using custom implementation */
	return custom_jwt_generate(exp_delta_s, jwt_buf, jwt_buf_sz, subject, sec_tag);
}
```

## src/jwt_impl.h
```c
/*
 * Copyright (c) 2025 Nordic Semiconductor ASA
 *
 * SPDX-License-Identifier: LicenseRef-Nordic-5-Clause
 */

#ifndef JWT_IMPL_H__
#define JWT_IMPL_H__

#include <stdint.h>
#include <stddef.h>

#ifdef __cplusplus
extern "C" {
#endif

/**
 * @brief Generate a JWT (JSON Web Token) for nRF Cloud authentication
 *
 * This function creates a JWT token signed with the device's private key
 * for authentication with nRF Cloud services.
 *
 * @param time_valid_s Time in seconds for which the JWT should be valid.
 *                     If 0, uses default validity period.
 *                     If > NRF_CLOUD_JWT_VALID_TIME_S_MAX, clamps to maximum.
 * @param jwt_buf      Buffer to store the generated JWT string.
 * @param jwt_buf_sz   Size of the JWT buffer.
 *
 * @retval 0        JWT successfully generated.
 * @retval -EINVAL  Invalid parameters.
 * @retval -ENOMEM  JWT buffer too small.
 * @retval -EBADF   Private key format error.
 * @retval <0       Other error codes from underlying subsystems.
 */
int nrf_cloud_jwt_generate(uint32_t time_valid_s, char *const jwt_buf, size_t jwt_buf_sz);

#ifdef __cplusplus
}
#endif

#endif /* JWT_IMPL_H__ */
```
