## CMakeLists.txt
```
#
# Copyright (c) 2018 Nordic Semiconductor
#
# SPDX-License-Identifier: LicenseRef-Nordic-5-Clause
#
cmake_minimum_required(VERSION 3.20.0)

find_package(Zephyr REQUIRED HINTS $ENV{ZEPHYR_BASE})
project(NONE)

# NORDIC SDK APP START
target_sources(app PRIVATE
  src/main.c
)

# NORDIC SDK APP END

target_sources_ifdef(CONFIG_NET_CORE_MONITOR app PRIVATE src/postmortem_monitor.c)
```

## Kconfig
```
#
# Copyright (c) 2018 Nordic Semiconductor
#
# SPDX-License-Identifier: LicenseRef-Nordic-5-Clause
#

source "Kconfig.zephyr"

menu "Nordic LED-Button BLE GATT service sample"

config MEMFAULT_EVENT_NOTIFY_INTERVAL_SECONDS
	int "Memfault event notification interval"
	default 10
	help
	  Interval, in seconds, at which the sample notifies a CBOR-encoded
	  Memfault event over the Memfault Event Service. The event is also
	  sent immediately whenever the user button is pressed or released.

config MEMFAULT_SOFTWARE_TYPE
	string "Software type embedded in the Memfault event payload"
	default "peripheral_lbs"

config MEMFAULT_SOFTWARE_VERSION
	string "Software version embedded in the Memfault event payload"
	default "1.0.0"

config MEMFAULT_HARDWARE_VERSION
	string "Hardware version embedded in the Memfault event payload"
	default BOARD_TARGET

config BT_LBS_SECURITY_ENABLED
	bool "Enable security"
	default y
	select BT_SMP
	select BT_SETTINGS
	select FLASH
	select FLASH_PAGE_LAYOUT
	select FLASH_MAP
	select ZMS if (SOC_FLASH_NRF_RRAM || SOC_FLASH_NRF_MRAM)
	select NVS if !(SOC_FLASH_NRF_RRAM || SOC_FLASH_NRF_MRAM)
	select SETTINGS
	help
	  "Enable BLE security for the LED-Button service"

endmenu
```

## prj.conf
```kconfig
#
# Copyright (c) 2018 Nordic Semiconductor
#
# SPDX-License-Identifier: LicenseRef-Nordic-5-Clause
#
CONFIG_NCS_SAMPLES_DEFAULTS=y

CONFIG_BT=y
CONFIG_BT_PERIPHERAL=y
CONFIG_BT_DEVICE_NAME="Nordic_LBS"
CONFIG_BT_MAX_CONN=2

# Enable the LBS service
CONFIG_BT_LBS=y
CONFIG_BT_LBS_POLL_BUTTON=y
CONFIG_DK_LIBRARY=y

CONFIG_SYSTEM_WORKQUEUE_STACK_SIZE=2048
```

## overlay-postmortem-poc.conf
```kconfig
#
# PoC overlay: read out the net core's retained-memory postmortem record
# on reset/freeze, via Nordic's Network Core Monitor (NCM).
#
# NCM's app-core-side poll loop (~1s default) needs no new signal from us —
# it already distinguishes a net-core RESET from a net-core FREEZE (wedged,
# never got to reset), which is exactly the case this PoC hit with the RPMSG
# HCI relay. See src/postmortem_monitor.c for the event handler.

CONFIG_NET_CORE_MONITOR=y
```

## prj_minimal.conf
```kconfig
# BEGIN Configurations from basic/minimal

CONFIG_NCS_SAMPLES_DEFAULTS=y

CONFIG_BT=y
CONFIG_BT_PERIPHERAL=y
CONFIG_BT_DEVICE_NAME="Nordic_LBS"

# Enable the LBS service
CONFIG_BT_LBS=y
CONFIG_BT_LBS_POLL_BUTTON=y
CONFIG_DK_LIBRARY=y

# Enable CBOR encoding for the Memfault Event Service
CONFIG_ZCBOR=y

# Derive the simulated Memfault device serial from the BLE MAC address
CONFIG_HW_ID_LIBRARY=y
CONFIG_HW_ID_LIBRARY_SOURCE_BLE_MAC=y

# Actively request an MTU exchange on connect, since not every central
# initiates one on its own
CONFIG_BT_GATT_CLIENT=y

# Drivers and peripherals
CONFIG_I2C=n
CONFIG_WATCHDOG=n
CONFIG_GPIO=n
CONFIG_SPI=n
CONFIG_SERIAL=n

# Power management

# Interrupts
CONFIG_DYNAMIC_INTERRUPTS=n
CONFIG_IRQ_OFFLOAD=n

# Memory protection
CONFIG_THREAD_STACK_INFO=n
CONFIG_THREAD_CUSTOM_DATA=n
CONFIG_FPU=n

# Boot
CONFIG_NCS_BOOT_BANNER=n
CONFIG_BOOT_BANNER=n
CONFIG_BOOT_DELAY=0

# Console
CONFIG_CONSOLE=n
CONFIG_UART_CONSOLE=n
CONFIG_STDOUT_CONSOLE=n
CONFIG_PRINTK=n
CONFIG_EARLY_CONSOLE=n

# Build
CONFIG_SIZE_OPTIMIZATIONS=y

# ARM
CONFIG_ARM_MPU=n
# END Configurations from basic/minimal

# In order to correctly tune the stack sizes for the threads the following
# Configurations can enabled to print the current use:
# CONFIG_THREAD_NAME=y
# CONFIG_THREAD_ANALYZER=y
# CONFIG_THREAD_ANALYZER_AUTO=y
# CONFIG_THREAD_ANALYZER_RUN_UNLOCKED=y
# CONFIG_THREAD_ANALYZER_USE_PRINTK=y
# CONFIG_CONSOLE=y
# CONFIG_UART_CONSOLE=y
# CONFIG_SERIAL=y
# CONFIG_PRINTK=y

# Example output of thread analyzer
# SDC RX              : unused 816 usage 208 / 1024 (20 %)
# BT RX               : unused 1784 usage 416 / 2200 (18 %)
# BT TX               : unused 992 usage 544 / 1536 (35 %)
# thread_analyzer     : unused 136 usage 376 / 512 (73 %)
# sysworkq            : unused 1824 usage 224 / 2048 (10 %)
# MPSL signal         : unused 520 usage 504 / 1024 (49 %)
# idle 00             : unused 192 usage 64 / 256 (25 %)
# main                : unused 136 usage 888 / 1024 (86 %)
# Configurations set based on thread analyzer output.
CONFIG_BT_RX_STACK_SIZE=1024
CONFIG_BT_HCI_TX_STACK_SIZE_WITH_PROMPT=y
CONFIG_BT_HCI_TX_STACK_SIZE=640
CONFIG_SYSTEM_WORKQUEUE_STACK_SIZE=1536
CONFIG_MPSL_WORK_STACK_SIZE=640
CONFIG_IDLE_STACK_SIZE=128
CONFIG_ISR_STACK_SIZE=1024

# Disable features not needed
CONFIG_TIMESLICING=n
CONFIG_COMMON_LIBC_MALLOC=n
CONFIG_LOG=n
CONFIG_ASSERT=n

# Disable Bluetooth features not needed
CONFIG_BT_DEBUG_NONE=y
CONFIG_BT_ASSERT=n
CONFIG_BT_DATA_LEN_UPDATE=n
CONFIG_BT_PHY_UPDATE=n
CONFIG_BT_GATT_CACHING=n
CONFIG_BT_GATT_SERVICE_CHANGED=n
CONFIG_BT_GAP_PERIPHERAL_PREF_PARAMS=n
CONFIG_BT_SETTINGS_CCC_LAZY_LOADING=y
CONFIG_BT_HCI_VS=n

# Disable Bluetooth controller features not needed
CONFIG_BT_CTLR_PRIVACY=n
CONFIG_BT_CTLR_PHY_2M=n

# Reduce Bluetooth buffers
CONFIG_BT_BUF_EVT_DISCARDABLE_COUNT=1
CONFIG_BT_BUF_EVT_DISCARDABLE_SIZE=43
CONFIG_BT_BUF_EVT_RX_COUNT=2

CONFIG_BT_CONN_TX_MAX=3
CONFIG_BT_L2CAP_TX_BUF_COUNT=2
CONFIG_BT_ATT_TX_COUNT=2
CONFIG_BT_BUF_EVT_RX_COUNT=4
CONFIG_BT_BUF_ACL_TX_COUNT=3
CONFIG_BT_BUF_ACL_TX_SIZE=27
```

## overlay-postmortem-poc.overlay
```dts
/*
 * PoC: app-core side of the same shared-memory split as
 * nrf/applications/ipc_radio/overlay-vs-fatal-error-poc.overlay. Must match
 * exactly — both cores are describing the same physical SRAM
 * (0x20070000-0x2007FFFF), just from their own devicetree.
 */

&sram0_shared {
	reg = <0x20070000 0xffe0>;
};

&{/reserved-memory} {
	net_core_postmortem: memory@2007ffe0 {
		reg = <0x2007ffe0 0x20>;
	};
};
```

## src/main.c
```c
/*
 * Copyright (c) 2018 Nordic Semiconductor ASA
 *
 * SPDX-License-Identifier: LicenseRef-Nordic-5-Clause
 */

#include <zephyr/types.h>
#include <stddef.h>
#include <string.h>
#include <errno.h>
#include <zephyr/sys/printk.h>
#include <zephyr/sys/byteorder.h>
#include <zephyr/kernel.h>
#include <zephyr/drivers/gpio.h>
#include <soc.h>

#include <zephyr/bluetooth/bluetooth.h>
#include <zephyr/bluetooth/hci.h>
#include <zephyr/bluetooth/conn.h>
#include <zephyr/bluetooth/uuid.h>
#include <zephyr/bluetooth/gatt.h>

#include <bluetooth/services/lbs.h>

#include <zephyr/settings/settings.h>

#include <dk_buttons_and_leds.h>

#define DEVICE_NAME             CONFIG_BT_DEVICE_NAME
#define DEVICE_NAME_LEN         (sizeof(DEVICE_NAME) - 1)


#define RUN_STATUS_LED          DK_LED1
#define CON_STATUS_LED          DK_LED2
#define RUN_LED_BLINK_INTERVAL  1000

#define USER_LED                DK_LED3

#define USER_BUTTON             DK_BTN1_MSK

static bool app_button_state;
static struct k_work adv_work;
static uint8_t conn_count;

static const struct bt_data ad[] = {
	BT_DATA_BYTES(BT_DATA_FLAGS, (BT_LE_AD_GENERAL | BT_LE_AD_NO_BREDR)),
	BT_DATA(BT_DATA_NAME_COMPLETE, DEVICE_NAME, DEVICE_NAME_LEN),
};

static const struct bt_data sd[] = {
	BT_DATA_BYTES(BT_DATA_UUID128_ALL, BT_UUID_LBS_VAL),
};

static void adv_work_handler(struct k_work *work)
{
	int err = bt_le_adv_start(BT_LE_ADV_CONN_FAST_2, ad, ARRAY_SIZE(ad), sd, ARRAY_SIZE(sd));

	if (err) {
		printk("Advertising failed to start (err %d)\n", err);
		return;
	}

	printk("Advertising successfully started\n");
}

static void advertising_start(void)
{
	k_work_submit(&adv_work);
}

static void connected(struct bt_conn *conn, uint8_t err)
{
	if (err) {
		printk("Connection failed, err 0x%02x %s\n", err, bt_hci_err_to_str(err));
		return;
	}

	printk("Connected\n");

	conn_count++;
	dk_set_led_on(CON_STATUS_LED);

	if (conn_count < CONFIG_BT_MAX_CONN) {
		/* Controller stops advertising on connect; resume so
		 * additional centrals can still connect.
		 */
		advertising_start();
	}
}

static void disconnected(struct bt_conn *conn, uint8_t reason)
{
	printk("Disconnected, reason 0x%02x %s\n", reason, bt_hci_err_to_str(reason));

	conn_count--;
	if (conn_count == 0) {
		dk_set_led_off(CON_STATUS_LED);
	}
}

static void recycled_cb(void)
{
	printk("Connection object available from previous conn. Disconnect is complete!\n");
	advertising_start();
}

#ifdef CONFIG_BT_LBS_SECURITY_ENABLED
static void security_changed(struct bt_conn *conn, bt_security_t level,
			     enum bt_security_err err)
{
	char addr[BT_ADDR_LE_STR_LEN];

	bt_addr_le_to_str(bt_conn_get_dst(conn), addr, sizeof(addr));

	if (!err) {
		printk("Security changed: %s level %u\n", addr, level);
	} else {
		printk("Security failed: %s level %u err %d %s\n", addr, level, err,
		       bt_security_err_to_str(err));
	}
}
#endif

BT_CONN_CB_DEFINE(conn_callbacks) = {
	.connected        = connected,
	.disconnected     = disconnected,
	.recycled         = recycled_cb,
#ifdef CONFIG_BT_LBS_SECURITY_ENABLED
	.security_changed = security_changed,
#endif
};

#if defined(CONFIG_BT_LBS_SECURITY_ENABLED)
static void auth_passkey_display(struct bt_conn *conn, unsigned int passkey)
{
	char addr[BT_ADDR_LE_STR_LEN];

	bt_addr_le_to_str(bt_conn_get_dst(conn), addr, sizeof(addr));

	printk("Passkey for %s: %06u\n", addr, passkey);
}

static void auth_cancel(struct bt_conn *conn)
{
	char addr[BT_ADDR_LE_STR_LEN];

	bt_addr_le_to_str(bt_conn_get_dst(conn), addr, sizeof(addr));

	printk("Pairing cancelled: %s\n", addr);
}

static void pairing_complete(struct bt_conn *conn, bool bonded)
{
	char addr[BT_ADDR_LE_STR_LEN];

	bt_addr_le_to_str(bt_conn_get_dst(conn), addr, sizeof(addr));

	printk("Pairing completed: %s, bonded: %d\n", addr, bonded);
}

static void pairing_failed(struct bt_conn *conn, enum bt_security_err reason)
{
	char addr[BT_ADDR_LE_STR_LEN];

	bt_addr_le_to_str(bt_conn_get_dst(conn), addr, sizeof(addr));

	printk("Pairing failed conn: %s, reason %d %s\n", addr, reason,
	       bt_security_err_to_str(reason));
}

static struct bt_conn_auth_cb conn_auth_callbacks = {
	.passkey_display = auth_passkey_display,
	.cancel = auth_cancel,
};

static struct bt_conn_auth_info_cb conn_auth_info_callbacks = {
	.pairing_complete = pairing_complete,
	.pairing_failed = pairing_failed
};
#else
static struct bt_conn_auth_cb conn_auth_callbacks;
static struct bt_conn_auth_info_cb conn_auth_info_callbacks;
#endif

static void app_led_cb(bool led_state)
{
	dk_set_led(USER_LED, led_state);
}

static bool app_button_cb(void)
{
	return app_button_state;
}

static struct bt_lbs_cb lbs_callbacs = {
	.led_cb    = app_led_cb,
	.button_cb = app_button_cb,
};

static void button_changed(uint32_t button_state, uint32_t has_changed)
{
	if (has_changed & USER_BUTTON) {
		uint32_t user_button_state = button_state & USER_BUTTON;

		bt_lbs_send_button_state(user_button_state);
		app_button_state = user_button_state ? true : false;
	}
}

static int init_button(void)
{
	int err;

	err = dk_buttons_init(button_changed);
	if (err) {
		printk("Cannot init buttons (err: %d)\n", err);
	}

	return err;
}

int main(void)
{
	int blink_status = 0;
	int err;

	printk("Starting Bluetooth Peripheral LBS sample\n");

	err = dk_leds_init();
	if (err) {
		printk("LEDs init failed (err %d)\n", err);
		return 0;
	}

	err = init_button();
	if (err) {
		printk("Button init failed (err %d)\n", err);
		return 0;
	}

	if (IS_ENABLED(CONFIG_BT_LBS_SECURITY_ENABLED)) {
		err = bt_conn_auth_cb_register(&conn_auth_callbacks);
		if (err) {
			printk("Failed to register authorization callbacks.\n");
			return 0;
		}

		err = bt_conn_auth_info_cb_register(&conn_auth_info_callbacks);
		if (err) {
			printk("Failed to register authorization info callbacks.\n");
			return 0;
		}
	}

	err = bt_enable(NULL);
	if (err) {
		printk("Bluetooth init failed (err %d)\n", err);
		return 0;
	}

	printk("Bluetooth initialized\n");

	if (IS_ENABLED(CONFIG_SETTINGS)) {
		settings_load();
	}

	err = bt_lbs_init(&lbs_callbacs);
	if (err) {
		printk("Failed to init LBS (err:%d)\n", err);
		return 0;
	}

	k_work_init(&adv_work, adv_work_handler);
	advertising_start();

	for (;;) {
		dk_set_led(RUN_STATUS_LED, (++blink_status) % 2);
		k_sleep(K_MSEC(RUN_LED_BLINK_INTERVAL));
	}
}
```

## src/memfault_event.c
```c
/*
 * Copyright (c) 2026 Nordic Semiconductor ASA
 *
 * SPDX-License-Identifier: LicenseRef-Nordic-5-Clause
 */

#include <errno.h>
#include <string.h>
#include <zephyr/types.h>
#include <zephyr/kernel.h>
#include <zephyr/sys/printk.h>
#include <zephyr/bluetooth/conn.h>
#include <zephyr/bluetooth/gatt.h>

#include <zcbor_encode.h>

#include "memfault_event.h"

/* Large enough for the map header, the 4 device info strings (bounded by
 * MEMFAULT_EVENT_DEVICE_INFO_STR_LEN each), and the 4 metric key/value pairs.
 */
#define MEMFAULT_EVENT_CBOR_BUF_SIZE 256

#define MEMFAULT_EVENT_DEVICE_INFO_STR_LEN 40

/* Not every central negotiates an ATT MTU large enough to fit the whole
 * event in a single notification (some stay at the 23-byte default, or
 * cap out lower than the encoded payload regardless). Rather than rely on
 * a large MTU, the event is split into fragments that each fit in whatever
 * MTU is in use, and reassembled on the host side. Each fragment is
 * prefixed with a 1-byte header: bits 0-6 are the 0-based fragment index,
 * and bit 7 is set on the last fragment.
 */
#define MEMFAULT_EVENT_FRAG_HEADER_LEN 1
#define MEMFAULT_EVENT_FRAG_LAST_BIT   0x80
#define MEMFAULT_EVENT_FRAG_INDEX_MAX  (MEMFAULT_EVENT_FRAG_LAST_BIT - 1)
#define MEMFAULT_EVENT_ATT_HEADER_LEN  3
#define MEMFAULT_EVENT_MIN_ATT_MTU     23

#define MEMFAULT_EVENT_NOTIFY_RETRY_COUNT 3
#define MEMFAULT_EVENT_NOTIFY_RETRY_DELAY K_MSEC(10)

static bool notify_enabled;
static struct bt_conn *active_conn;

static char device_serial[MEMFAULT_EVENT_DEVICE_INFO_STR_LEN];
static char software_type[MEMFAULT_EVENT_DEVICE_INFO_STR_LEN];
static char software_version[MEMFAULT_EVENT_DEVICE_INFO_STR_LEN];
static char hardware_version[MEMFAULT_EVENT_DEVICE_INFO_STR_LEN];

static void mfld_ccc_cfg_changed(const struct bt_gatt_attr *attr, uint16_t value)
{
	ARG_UNUSED(attr);

	notify_enabled = (value == BT_GATT_CCC_NOTIFY);
	printk("Memfault event notifications %s\n", notify_enabled ? "enabled" : "disabled");
}

BT_GATT_SERVICE_DEFINE(memfault_event_svc,
	BT_GATT_PRIMARY_SERVICE(BT_UUID_MEMFAULT_EVENT_SVC),
	BT_GATT_CHARACTERISTIC(BT_UUID_MEMFAULT_EVENT_DATA, BT_GATT_CHRC_NOTIFY,
				BT_GATT_PERM_NONE, NULL, NULL, NULL),
	BT_GATT_CCC(mfld_ccc_cfg_changed, BT_GATT_PERM_READ | BT_GATT_PERM_WRITE),
);

void memfault_event_set_device_info(const char *serial, const char *sw_type,
				     const char *sw_version, const char *hw_version)
{
	strncpy(device_serial, serial, sizeof(device_serial) - 1);
	strncpy(software_type, sw_type, sizeof(software_type) - 1);
	strncpy(software_version, sw_version, sizeof(software_version) - 1);
	strncpy(hardware_version, hw_version, sizeof(hardware_version) - 1);
}

void memfault_event_svc_set_conn(struct bt_conn *conn)
{
	active_conn = conn;
}

static int send_fragments(struct bt_conn *conn, const uint8_t *data, size_t len)
{
	/* MEMFAULT_EVENT_CBOR_BUF_SIZE comfortably fits in one fragment's
	 * data portion even at the largest realistic negotiated MTU, so
	 * sizing the scratch buffer off of it covers every chunk size below.
	 */
	uint8_t frag_buf[MEMFAULT_EVENT_FRAG_HEADER_LEN + MEMFAULT_EVENT_CBOR_BUF_SIZE];
	uint16_t att_mtu = conn ? bt_gatt_get_mtu(conn) : MEMFAULT_EVENT_MIN_ATT_MTU;
	size_t max_chunk_len;
	size_t num_frags;

	if (att_mtu < MEMFAULT_EVENT_MIN_ATT_MTU) {
		att_mtu = MEMFAULT_EVENT_MIN_ATT_MTU;
	}

	max_chunk_len = att_mtu - MEMFAULT_EVENT_ATT_HEADER_LEN - MEMFAULT_EVENT_FRAG_HEADER_LEN;
	num_frags = DIV_ROUND_UP(len, max_chunk_len);

	if (num_frags > MEMFAULT_EVENT_FRAG_INDEX_MAX + 1) {
		printk("Memfault event too large to fragment (%zu fragments needed)\n",
		       num_frags);
		return -EMSGSIZE;
	}

	for (size_t i = 0; i < num_frags; i++) {
		size_t offset = i * max_chunk_len;
		size_t chunk_len = MIN(max_chunk_len, len - offset);
		int err;

		frag_buf[0] = i;
		if (i == num_frags - 1) {
			frag_buf[0] |= MEMFAULT_EVENT_FRAG_LAST_BIT;
		}
		memcpy(&frag_buf[MEMFAULT_EVENT_FRAG_HEADER_LEN], &data[offset], chunk_len);

		for (int attempt = 0; attempt < MEMFAULT_EVENT_NOTIFY_RETRY_COUNT; attempt++) {
			err = bt_gatt_notify(conn, &memfault_event_svc.attrs[2], frag_buf,
					     chunk_len + MEMFAULT_EVENT_FRAG_HEADER_LEN);
			if (err != -ENOMEM) {
				break;
			}
			k_sleep(MEMFAULT_EVENT_NOTIFY_RETRY_DELAY);
		}

		if (err) {
			printk("Failed to notify Memfault event fragment %zu/%zu (err %d)\n",
			       i + 1, num_frags, err);
			return err;
		}
	}

	return 0;
}

int memfault_event_notify(uint32_t uptime_s, bool button_state, uint32_t button_presses,
			   int32_t batt_mv)
{
	uint8_t cbor_buf[MEMFAULT_EVENT_CBOR_BUF_SIZE];
	ZCBOR_STATE_E(state, 0, cbor_buf, sizeof(cbor_buf), 1);
	bool ok;

	if (!notify_enabled || !active_conn) {
		return -EACCES;
	}

	ok = zcbor_map_start_encode(state, 8) &&
	     zcbor_tstr_put_lit(state, "device_serial") &&
	     zcbor_tstr_put_term(state, device_serial, sizeof(device_serial)) &&
	     zcbor_tstr_put_lit(state, "software_type") &&
	     zcbor_tstr_put_term(state, software_type, sizeof(software_type)) &&
	     zcbor_tstr_put_lit(state, "software_version") &&
	     zcbor_tstr_put_term(state, software_version, sizeof(software_version)) &&
	     zcbor_tstr_put_lit(state, "hardware_version") &&
	     zcbor_tstr_put_term(state, hardware_version, sizeof(hardware_version)) &&
	     zcbor_tstr_put_lit(state, "uptime_s") && zcbor_uint32_put(state, uptime_s) &&
	     zcbor_tstr_put_lit(state, "button") && zcbor_bool_put(state, button_state) &&
	     zcbor_tstr_put_lit(state, "button_presses") &&
	     zcbor_uint32_put(state, button_presses) &&
	     zcbor_tstr_put_lit(state, "batt_mv") && zcbor_int32_put(state, batt_mv) &&
	     zcbor_map_end_encode(state, 8);

	if (!ok) {
		printk("Failed to CBOR-encode Memfault event\n");
		return -EINVAL;
	}

	size_t len = state->payload - cbor_buf;

	printk("Sending Memfault event to peer: uptime_s=%u button=%u button_presses=%u "
	       "batt_mv=%d (%zu bytes)\n",
	       uptime_s, button_state, button_presses, batt_mv, len);

	return send_fragments(active_conn, cbor_buf, len);
}
```

## src/memfault_event.h
```c
/*
 * Copyright (c) 2026 Nordic Semiconductor ASA
 *
 * SPDX-License-Identifier: LicenseRef-Nordic-5-Clause
 */

#ifndef MEMFAULT_EVENT_H_
#define MEMFAULT_EVENT_H_

/**@file
 * @defgroup bt_memfault_event Memfault Event Service
 * @{
 * @brief GATT service that streams device metrics as a CBOR payload.
 *
 * The characteristic exposed by this service is intended to be relayed by a
 * host-side application to the Memfault "Ingress" events API
 * (https://api-docs.memfault.com/#7267d576-ee78-4d1c-b7a3-8fc4dd82ce04).
 * See :file:`scripts/memfault_ble_relay.py` for a reference relay
 * implementation.
 *
 * The Memfault device identity fields (device serial, software type,
 * software version, and hardware version) are embedded in every CBOR
 * payload, simulating a self-describing custom data package coming from a
 * downstream device that the host has no other knowledge of.
 *
 * Since the encoded payload does not reliably fit in a single notification
 * (not every central negotiates a large ATT MTU), each event is split into
 * fragments that individually fit the connection's negotiated MTU. See
 * :file:`scripts/memfault_ble_relay.py` for the reassembly logic.
 */

#include <zephyr/types.h>
#include <zephyr/bluetooth/conn.h>
#include <zephyr/bluetooth/uuid.h>

/** @brief Memfault Event Service UUID. */
#define BT_UUID_MEMFAULT_EVENT_SVC_VAL \
	BT_UUID_128_ENCODE(0x00001526, 0x1212, 0xefde, 0x1523, 0x785feabcd123)

/** @brief Memfault Event Data Characteristic UUID. */
#define BT_UUID_MEMFAULT_EVENT_DATA_VAL \
	BT_UUID_128_ENCODE(0x00001527, 0x1212, 0xefde, 0x1523, 0x785feabcd123)

#define BT_UUID_MEMFAULT_EVENT_SVC  BT_UUID_DECLARE_128(BT_UUID_MEMFAULT_EVENT_SVC_VAL)
#define BT_UUID_MEMFAULT_EVENT_DATA BT_UUID_DECLARE_128(BT_UUID_MEMFAULT_EVENT_DATA_VAL)

/** @brief Set the Memfault device identity embedded in every notified event.
 *
 * Each string is copied internally, so the arguments do not need to remain
 * valid after this call returns. Call this once, before the first call to
 * @ref memfault_event_notify.
 *
 * @param[in] device_serial     Device serial, for example derived from a
 *                               hardware identifier.
 * @param[in] software_type     Software type, for example the application
 *                               name.
 * @param[in] software_version  Software version.
 * @param[in] hardware_version  Hardware version, for example the board
 *                               target.
 */
void memfault_event_set_device_info(const char *device_serial, const char *software_type,
				     const char *software_version,
				     const char *hardware_version);

/** @brief Set the connection that Memfault events are sent to.
 *
 * Call this with the active connection when a central connects, and with
 * NULL when it disconnects. This sample only tracks a single connection at
 * a time.
 *
 * @param[in] conn The active connection, or NULL if none.
 */
void memfault_event_svc_set_conn(struct bt_conn *conn);

/** @brief Encode the current metrics as CBOR and notify subscribed peers.
 *
 * The resulting CBOR payload is a map with the following keys:
 *
 * - "device_serial" (tstr): Device serial, as set by
 *   @ref memfault_event_set_device_info.
 * - "software_type" (tstr): Software type, as set by
 *   @ref memfault_event_set_device_info.
 * - "software_version" (tstr): Software version, as set by
 *   @ref memfault_event_set_device_info.
 * - "hardware_version" (tstr): Hardware version, as set by
 *   @ref memfault_event_set_device_info.
 * - "uptime_s" (uint): Seconds since boot.
 * - "button" (bool): Current state of the user button.
 * - "button_presses" (uint): Number of button presses since boot.
 * - "batt_mv" (int): Simulated battery voltage, in millivolts.
 *
 * The payload is split into one or more notifications; see this file's
 * top-level comment for the fragmentation format.
 *
 * @param[in] uptime_s        Seconds since boot.
 * @param[in] button_state    Current state of the user button.
 * @param[in] button_presses  Number of button presses since boot.
 * @param[in] batt_mv         Simulated battery voltage, in millivolts.
 *
 * @retval 0 If the operation was successful.
 *           Otherwise, a (negative) error code is returned.
 */
int memfault_event_notify(uint32_t uptime_s, bool button_state, uint32_t button_presses,
			   int32_t batt_mv);

/**
 * @}
 */

#endif /* MEMFAULT_EVENT_H_ */
```

## src/postmortem_monitor.c
```c
/*
 * Copyright (c) 2026 Nordic Semiconductor ASA
 *
 * SPDX-License-Identifier: LicenseRef-Nordic-5-Clause
 *
 * PoC: override Network Core Monitor's event handler to read out the net
 * core's retained-memory postmortem record (nrf/include/net_core_postmortem.h)
 * whenever NCM reports the net core reset or froze. No polling of our own,
 * no extra signal needed — NCM already provides the trigger.
 */

#include <stdint.h>

#include <net_core_monitor.h>
#include <net_core_postmortem.h>

#include <zephyr/logging/log.h>

LOG_MODULE_REGISTER(net_core_postmortem, LOG_LEVEL_INF);

void ncm_net_core_event_handler(enum ncm_event_type event, uint32_t reset_reas)
{
	volatile struct net_core_postmortem *pm = net_core_postmortem_get();

	switch (event) {
	case NCM_EVT_NET_CORE_RESET:
		LOG_WRN("Network core reset (RESETREAS=0x%08x)", reset_reas);
		break;
	case NCM_EVT_NET_CORE_FREEZE:
		LOG_WRN("Network core is not responding (frozen, no reset seen)");
		break;
	}

	if (pm->magic == NET_CORE_POSTMORTEM_MAGIC && pm->valid) {
		LOG_ERR("Network core fault record: reason=%u pc=0x%08x lr=0x%08x "
			"xpsr=0x%08x seq=%u",
			pm->reason, pm->pc, pm->lr, pm->xpsr, pm->seq);
		pm->valid = 0;
	} else {
		LOG_INF("No postmortem record present (magic=0x%08x valid=%u)", pm->magic,
			pm->valid);
	}
}
```
